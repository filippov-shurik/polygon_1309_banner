/* USER CODE BEGIN Header */
/**
 ******************************************************************************
 * @file           : main.c
 * @brief          : Main program body
 ******************************************************************************
 * @attention
 *
 * Copyright (c) 2022 STMicroelectronics.
 * All rights reserved.
 *
 * This software is licensed under terms that can be found in the LICENSE file
 * in the root directory of this software component.
 * If no LICENSE file comes with this software, it is provided AS-IS.
 *
 ******************************************************************************
 */
/* USER CODE END Header */
/* Includes ------------------------------------------------------------------*/
#include "main.h"

/* Private includes ----------------------------------------------------------*/
/* USER CODE BEGIN Includes */
#include "stm32f4xx_it.h"
#include "ssd1306.h"
#include "ssd1306_tests.h"
#include "ssd1306_fonts.h"
#include <stdbool.h>
/* USER CODE END Includes */

/* Private typedef -----------------------------------------------------------*/
/* USER CODE BEGIN PTD */

#define I2C_ADDRESSO 0x48

#define display_start 0x00
#define display_panel_1 0x01
#define display_panel_2 0x02
#define display_panel_3 0x03
#define download 0x09
volatile uint8_t isDownload = 0;
volatile uint16_t download_index = 0;
#define display_xbm 0x10
volatile uint8_t status_display = display_start;

volatile uint8_t xbm_width = 128;
volatile uint8_t xbm_height = 64;
volatile uint8_t xbm_data[1024] =
{  0x00, 0x00, 0x00, 0x00, 0x00, 0x00, 0x00, 0x00, 0x00, 0x00, 0x00, 0x00, 0x00,
		0x00, 0x00, 0x00, 0x00, 0x00, 0x00, 0x00, 0x00, 0x00, 0x00, 0x00, 0x00,
		0x00, 0x00, 0x00, 0x00, 0x00, 0x00, 0x00, 0x00, 0x00, 0x00, 0x00, 0x00,
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		0x00, 0x00, 0x00 };

/* USER CODE END PTD */

/* Private define ------------------------------------------------------------*/
/* USER CODE BEGIN PD */
/* USER CODE END PD */

/* Private macro -------------------------------------------------------------*/
/* USER CODE BEGIN PM */

/* USER CODE END PM */

/* Private variables ---------------------------------------------------------*/
I2C_HandleTypeDef hi2c1;

/* USER CODE BEGIN PV */
void I2C2_EV_IRQHandler(void)
{
	/* USER CODE BEGIN I2C2_EV_IRQn 0 */
	/* USER CODE END I2C2_EV_IRQn 0 */
	/* USER CODE BEGIN I2C2_EV_IRQn 1 */
	/* Check ADDR flag value in ISR register */
	if (LL_I2C_IsActiveFlag_ADDR(I2C2))
	{
		/* Verify the transfer direction, a write direction, Slave enters receiver mode */
		if (LL_I2C_GetTransferDirection(I2C2) == LL_I2C_DIRECTION_WRITE) //主机读
		{
			/* Enable Buffer Interrupts */
			LL_I2C_EnableIT_BUF(I2C2);
			/* Clear ADDR flag value in ISR register */
			LL_I2C_ClearFlag_ADDR(I2C2);
		}
		else if (LL_I2C_GetTransferDirection(I2C2) == LL_I2C_DIRECTION_READ) //主机写
		{
			/* Enable Buffer Interrupts */
			LL_I2C_EnableIT_BUF(I2C2);
			/* Clear ADDR flag value in ISR register */
			LL_I2C_ClearFlag_ADDR(I2C2);
		}
		else
		{
			/* Clear ADDR flag value in ISR register */
			LL_I2C_ClearFlag_ADDR(I2C2);
		}
	}
	/* Check TXE flag value in ISR register */
	if (LL_I2C_IsActiveFlag_TXE(I2C2))
	{
		//LL_I2C_TransmitData8(I2C2, aTXBuffer[ubTXIndex++]);
	}
	/* Check BTF flag value in ISR register */
	if (LL_I2C_IsActiveFlag_BTF(I2C2))
	{
		//LL_I2C_TransmitData8(I2C2, aTXBuffer[ubTXIndex++]);
	}
	/* Check RXNE flag value in ISR register */
	if (LL_I2C_IsActiveFlag_RXNE(I2C2))
	{
		/* Call function Slave Reception Callback */
		uint8_t temp = LL_I2C_ReceiveData8(I2C2);
		if (isDownload == 1)
		{
			if (download_index < 1024 - 1)
			{
				xbm_data[download_index] = temp;
				download_index++;
			}
			else
			{
				download_index = 0;
				isDownload = 0;
			}
		}
		else
		{
			switch (temp)
			{
			case 0x01:
				status_display = 0x01;
				break;
			case 0x02:
				status_display = 0x02;
				break;
			case 0x03:
				status_display = 0x03;
				break;
			case 0x09:
				isDownload = 1;
				break;
			case display_xbm:
				status_display = display_xbm;
				break;
			default:
				status_display = 0x00;
				break;
			}
			temp = 0;
		}
	}
	/* Check BTF flag value in ISR register */
	if (LL_I2C_IsActiveFlag_BTF(I2C1))
	{
		/* Call function Slave Reception Callback */
	}
	/* Check STOP flag value in ISR register */
	if (LL_I2C_IsActiveFlag_STOP(I2C2))
	{
		/* Clear STOP flag value in ISR register */
		LL_I2C_ClearFlag_STOP(I2C2);
	}
	/* USER CODE END I2C2_EV_IRQn 1 */
}
/* USER CODE END PV */

/* Private function prototypes -----------------------------------------------*/
void SystemClock_Config(void);
static void MX_GPIO_Init(void);
static void MX_I2C1_Init(void);
static void MX_I2C2_Init(void);
static void MX_NVIC_Init(void);
/* USER CODE BEGIN PFP */

/* USER CODE END PFP */

/* Private user code ---------------------------------------------------------*/
/* USER CODE BEGIN 0 */

/* USER CODE END 0 */

/**
 * @brief  The application entry point.
 * @retval int
 */
int main(void)
{
	/* USER CODE BEGIN 1 */

	/* USER CODE END 1 */

	/* MCU Configuration--------------------------------------------------------*/

	/* Reset of all peripherals, Initializes the Flash interface and the Systick. */
	HAL_Init();

	/* USER CODE BEGIN Init */

	/* USER CODE END Init */

	/* Configure the system clock */
	SystemClock_Config();

	/* USER CODE BEGIN SysInit */

	/* USER CODE END SysInit */

	/* Initialize all configured peripherals */
	MX_GPIO_Init();
	MX_I2C1_Init();
	MX_I2C2_Init();

	/* Initialize interrupts */
	MX_NVIC_Init();
	/* USER CODE BEGIN 2 */
	ssd1306_Init();
	ssd1306_SetContrast(0x00);
	/* USER CODE END 2 */

	/* Infinite loop */
	/* USER CODE BEGIN WHILE */

	HAL_Delay(1000);
	while (1)
	{
		if (isDownload == 0)
		{
			ssd1306_Fill(Black);
			switch (status_display)
			{
			case display_start:
			{
				ssd1306_SetCursor(36, 0);
				ssd1306_WriteString("no service", Font_6x8, 1);
				break;
			}
			case display_panel_1:
			{
				ssd1306_SetCursor(32, 0);
				ssd1306_WriteString("panel_1", Font_6x8, 1);
				break;
			}
			case display_panel_2:
			{
				ssd1306_SetCursor(32, 0);
				ssd1306_WriteString("panel_2", Font_6x8, 1);
				break;
			}
			case display_panel_3:
			{
				ssd1306_SetCursor(32, 0);
				ssd1306_WriteString("panel_3", Font_6x8, 1);
				break;
			}
			case display_xbm:
			{
				ssd1306_DrawBitmap(0, 0, xbm_data, xbm_width, xbm_height, 1);
				break;
			}
			default:
				break;
			}
			ssd1306_UpdateScreen();
			HAL_Delay(1000);
		}
		/* USER CODE END WHILE */

		/* USER CODE BEGIN 3 */
	}

	/* USER CODE END 3 */
}

/**
 * @brief System Clock Configuration
 * @retval None
 */
void SystemClock_Config(void)
{
	RCC_OscInitTypeDef RCC_OscInitStruct =
	{ 0 };
	RCC_ClkInitTypeDef RCC_ClkInitStruct =
	{ 0 };

	/** Configure the main internal regulator output voltage
	 */
	__HAL_RCC_PWR_CLK_ENABLE();
	__HAL_PWR_VOLTAGESCALING_CONFIG(PWR_REGULATOR_VOLTAGE_SCALE1);

	/** Initializes the RCC Oscillators according to the specified parameters
	 * in the RCC_OscInitTypeDef structure.
	 */
	RCC_OscInitStruct.OscillatorType = RCC_OSCILLATORTYPE_HSI;
	RCC_OscInitStruct.HSIState = RCC_HSI_ON;
	RCC_OscInitStruct.HSICalibrationValue = RCC_HSICALIBRATION_DEFAULT;
	RCC_OscInitStruct.PLL.PLLState = RCC_PLL_ON;
	RCC_OscInitStruct.PLL.PLLSource = RCC_PLLSOURCE_HSI;
	RCC_OscInitStruct.PLL.PLLM = 8;
	RCC_OscInitStruct.PLL.PLLN = 100;
	RCC_OscInitStruct.PLL.PLLP = RCC_PLLP_DIV2;
	RCC_OscInitStruct.PLL.PLLQ = 4;
	if (HAL_RCC_OscConfig(&RCC_OscInitStruct) != HAL_OK)
	{
		Error_Handler();
	}

	/** Initializes the CPU, AHB and APB buses clocks
	 */
	RCC_ClkInitStruct.ClockType = RCC_CLOCKTYPE_HCLK | RCC_CLOCKTYPE_SYSCLK
			| RCC_CLOCKTYPE_PCLK1 | RCC_CLOCKTYPE_PCLK2;
	RCC_ClkInitStruct.SYSCLKSource = RCC_SYSCLKSOURCE_PLLCLK;
	RCC_ClkInitStruct.AHBCLKDivider = RCC_SYSCLK_DIV1;
	RCC_ClkInitStruct.APB1CLKDivider = RCC_HCLK_DIV2;
	RCC_ClkInitStruct.APB2CLKDivider = RCC_HCLK_DIV1;

	if (HAL_RCC_ClockConfig(&RCC_ClkInitStruct, FLASH_LATENCY_3) != HAL_OK)
	{
		Error_Handler();
	}
}

/**
 * @brief NVIC Configuration.
 * @retval None
 */
static void MX_NVIC_Init(void)
{
	/* I2C2_EV_IRQn interrupt configuration */
	NVIC_SetPriority(I2C2_EV_IRQn,
			NVIC_EncodePriority(NVIC_GetPriorityGrouping(), 0, 0));
	NVIC_EnableIRQ(I2C2_EV_IRQn);
	/* I2C2_ER_IRQn interrupt configuration */
	NVIC_SetPriority(I2C2_ER_IRQn,
			NVIC_EncodePriority(NVIC_GetPriorityGrouping(), 0, 0));
	NVIC_EnableIRQ(I2C2_ER_IRQn);
}

/**
 * @brief I2C1 Initialization Function
 * @param None
 * @retval None
 */
static void MX_I2C1_Init(void)
{

	/* USER CODE BEGIN I2C1_Init 0 */

	/* USER CODE END I2C1_Init 0 */

	/* USER CODE BEGIN I2C1_Init 1 */

	/* USER CODE END I2C1_Init 1 */
	hi2c1.Instance = I2C1;
	hi2c1.Init.ClockSpeed = 100000;
	hi2c1.Init.DutyCycle = I2C_DUTYCYCLE_2;
	hi2c1.Init.OwnAddress1 = 0;
	hi2c1.Init.AddressingMode = I2C_ADDRESSINGMODE_7BIT;
	hi2c1.Init.DualAddressMode = I2C_DUALADDRESS_DISABLE;
	hi2c1.Init.OwnAddress2 = 0;
	hi2c1.Init.GeneralCallMode = I2C_GENERALCALL_DISABLE;
	hi2c1.Init.NoStretchMode = I2C_NOSTRETCH_DISABLE;
	if (HAL_I2C_Init(&hi2c1) != HAL_OK)
	{
		Error_Handler();
	}
	/* USER CODE BEGIN I2C1_Init 2 */

	/* USER CODE END I2C1_Init 2 */

}

/**
 * @brief I2C2 Initialization Function
 * @param None
 * @retval None
 */
static void MX_I2C2_Init(void)
{

	/* USER CODE BEGIN I2C2_Init 0 */

	/* USER CODE END I2C2_Init 0 */

	LL_I2C_InitTypeDef I2C_InitStruct =
	{ 0 };

	LL_GPIO_InitTypeDef GPIO_InitStruct =
	{ 0 };

	LL_AHB1_GRP1_EnableClock(LL_AHB1_GRP1_PERIPH_GPIOB);
	/**I2C2 GPIO Configuration
	 PB10   ------> I2C2_SCL
	 PB9   ------> I2C2_SDA
	 */
	GPIO_InitStruct.Pin = LL_GPIO_PIN_10;
	GPIO_InitStruct.Mode = LL_GPIO_MODE_ALTERNATE;
	GPIO_InitStruct.Speed = LL_GPIO_SPEED_FREQ_VERY_HIGH;
	GPIO_InitStruct.OutputType = LL_GPIO_OUTPUT_OPENDRAIN;
	GPIO_InitStruct.Pull = LL_GPIO_PULL_NO;
	GPIO_InitStruct.Alternate = LL_GPIO_AF_4;
	LL_GPIO_Init(GPIOB, &GPIO_InitStruct);

	GPIO_InitStruct.Pin = LL_GPIO_PIN_9;
	GPIO_InitStruct.Mode = LL_GPIO_MODE_ALTERNATE;
	GPIO_InitStruct.Speed = LL_GPIO_SPEED_FREQ_VERY_HIGH;
	GPIO_InitStruct.OutputType = LL_GPIO_OUTPUT_OPENDRAIN;
	GPIO_InitStruct.Pull = LL_GPIO_PULL_NO;
	GPIO_InitStruct.Alternate = LL_GPIO_AF_9;
	LL_GPIO_Init(GPIOB, &GPIO_InitStruct);

	/* Peripheral clock enable */
	LL_APB1_GRP1_EnableClock(LL_APB1_GRP1_PERIPH_I2C2);

	/* USER CODE BEGIN I2C2_Init 1 */

	/* USER CODE END I2C2_Init 1 */

	/** I2C Initialization
	 */
	LL_I2C_DisableOwnAddress2(I2C2);
	LL_I2C_DisableGeneralCall(I2C2);
	LL_I2C_EnableClockStretching(I2C2);
	I2C_InitStruct.PeripheralMode = LL_I2C_MODE_I2C;
	I2C_InitStruct.ClockSpeed = 100000;
	I2C_InitStruct.DutyCycle = LL_I2C_DUTYCYCLE_2;
	I2C_InitStruct.OwnAddress1 = (I2C_ADDRESSO << 1);
	I2C_InitStruct.TypeAcknowledge = LL_I2C_ACK;
	I2C_InitStruct.OwnAddrSize = LL_I2C_OWNADDRESS1_7BIT;
	LL_I2C_Init(I2C2, &I2C_InitStruct);
	LL_I2C_SetOwnAddress2(I2C2, (I2C_ADDRESSO << 1));
	/* USER CODE BEGIN I2C2_Init 2 */
	LL_I2C_Enable(I2C2);
	LL_I2C_EnableIT_EVT(I2C2);
	//LL_I2C_EnableIT_ERR(I2C2);
	/* USER CODE END I2C2_Init 2 */

}

/**
 * @brief GPIO Initialization Function
 * @param None
 * @retval None
 */
static void MX_GPIO_Init(void)
{
	GPIO_InitTypeDef GPIO_InitStruct =
	{ 0 };

	/* GPIO Ports Clock Enable */
	__HAL_RCC_GPIOC_CLK_ENABLE();
	__HAL_RCC_GPIOH_CLK_ENABLE();
	__HAL_RCC_GPIOA_CLK_ENABLE();
	__HAL_RCC_GPIOB_CLK_ENABLE();

	/*Configure GPIO pin Output Level */
	HAL_GPIO_WritePin(Led_GPIO_Port, Led_Pin, GPIO_PIN_SET);

	/*Configure GPIO pin : Led_Pin */
	GPIO_InitStruct.Pin = Led_Pin;
	GPIO_InitStruct.Mode = GPIO_MODE_OUTPUT_PP;
	GPIO_InitStruct.Pull = GPIO_NOPULL;
	GPIO_InitStruct.Speed = GPIO_SPEED_FREQ_LOW;
	HAL_GPIO_Init(Led_GPIO_Port, &GPIO_InitStruct);

	/*Configure GPIO pin : Key_Pin */
	GPIO_InitStruct.Pin = Key_Pin;
	GPIO_InitStruct.Mode = GPIO_MODE_INPUT;
	GPIO_InitStruct.Pull = GPIO_PULLUP;
	HAL_GPIO_Init(Key_GPIO_Port, &GPIO_InitStruct);

}

/* USER CODE BEGIN 4 */

/* USER CODE END 4 */

/**
 * @brief  This function is executed in case of error occurrence.
 * @retval None
 */
void Error_Handler(void)
{
	/* USER CODE BEGIN Error_Handler_Debug */
	/* User can add his own implementation to report the HAL error return state */
	__disable_irq();
	while (1)
	{
	}
	/* USER CODE END Error_Handler_Debug */
}

#ifdef  USE_FULL_ASSERT
/**
  * @brief  Reports the name of the source file and the source line number
  *         where the assert_param error has occurred.
  * @param  file: pointer to the source file name
  * @param  line: assert_param error line source number
  * @retval None
  */
void assert_failed(uint8_t *file, uint32_t line)
{
  /* USER CODE BEGIN 6 */
  /* User can add his own implementation to report the file name and line number,
     ex: printf("Wrong parameters value: file %s on line %d\r\n", file, line) */
  /* USER CODE END 6 */
}
#endif /* USE_FULL_ASSERT */
